## src/Kconfig
```kconfig
# Main Kconfig settings

mainmenu "Klipper Firmware Configuration"

config LOW_LEVEL_OPTIONS
    bool "Enable extra low-level configuration options"
    help
        Enable low-level configuration options that (if modified) may
        result in a build that does not function correctly.

choice
    prompt "Micro-controller Architecture"
    config MACH_STM32
        bool "STMicroelectronics STM32"
    config MACH_RPXXXX
        bool "Raspberry Pi RP2040/RP235x"
    config MACH_LINUX
        bool "Linux process"
    config MACH_SIMU
        bool "Host simulator"
endchoice

# MCU-specific configurations (commented out removed MCUs)
# source "src/avr/Kconfig"        # AVR - removed
# source "src/atsam/Kconfig"      # SAM - removed
# source "src/atsamd/Kconfig"     # SAMD - removed
# source "src/lpc176x/Kconfig"    # LPC - removed
source "src/stm32/Kconfig"       # STM32 - keep for CNC development
# source "src/hc32f460/Kconfig"   # HC32 - removed
source "src/rp2040/Kconfig"     # RP2040 - removed
# source "src/pru/Kconfig"        # PRU - removed
# source "src/ar100/Kconfig"      # AR100 - removed
# source "src/linux/Kconfig"      # Linux - removed
# source "src/simulator/Kconfig"  # Simulator - removed

# Generic configuration options for serial ports
config SERIAL
    bool
config SERIAL_BAUD
    depends on SERIAL
    int "Baud rate for serial port" if LOW_LEVEL_OPTIONS
    default 250000
    help
        Specify the baud rate of the serial port. This should be set
        to 250000. Read the FAQ before changing this value.

# Generic configuration options for USB
config USBSERIAL
    bool
config USBCANBUS
    bool
config USB
    bool
    default y if USBSERIAL || USBCANBUS
config USB_VENDOR_ID
    default 0x1d50
config USB_DEVICE_ID
    default 0x614e
config USB_SERIAL_NUMBER_CHIPID
    depends on USB && HAVE_CHIPID
    default y
config USB_SERIAL_NUMBER
    default "12345"

menu "USB ids"
    depends on USB && LOW_LEVEL_OPTIONS
config USB_VENDOR_ID
    hex "USB vendor ID" if USBSERIAL
config USB_DEVICE_ID
    hex "USB device ID" if USBSERIAL
config USB_SERIAL_NUMBER_CHIPID
    bool "USB serial number from CHIPID" if HAVE_CHIPID
config USB_SERIAL_NUMBER
    string "USB serial number" if !USB_SERIAL_NUMBER_CHIPID
endmenu

# Optional features that can be disabled (for devices with small flash sizes)
# Defaults optimized for CNC winder application
config WANT_ADC
    bool
    depends on HAVE_GPIO_ADC
    default y  # Keep for analog sensors (tension, position)
config WANT_SPI
    bool
    depends on HAVE_GPIO && HAVE_GPIO_SPI
    default y  # Keep for TMC drivers and external chips
config WANT_SOFTWARE_SPI
    bool
    depends on WANT_SPI
    default y
config WANT_I2C
    bool
    depends on HAVE_GPIO && HAVE_GPIO_I2C
    default y  # Keep for external sensors/displays
config WANT_SOFTWARE_I2C
    bool
    depends on WANT_I2C
    default y
config WANT_HARD_PWM
    bool
    depends on HAVE_GPIO_HARD_PWM
    default y  # Keep for motor speed/tension control
config WANT_BUTTONS
    bool
    depends on HAVE_GPIO
    default y  # Keep for physical controls (start/stop/jog)
config WANT_TMCUART
    bool
    depends on HAVE_GPIO
    default y  # Keep for TMC stepper driver control
config WANT_NEOPIXEL
    bool
    depends on HAVE_GPIO
    default n  # Disabled - LED strips not needed for CNC winder
config WANT_PULSE_COUNTER
    bool
    depends on HAVE_GPIO
    default y  # Keep for encoder feedback
config WANT_THERMOCOUPLE
    bool
    depends on WANT_SPI
    default n  # Disabled - temperature sensing not needed for CNC winder
menu "Optional features (to reduce code size)"
    depends on HAVE_LIMITED_CODE_SIZE
config WANT_ADC
    bool "Support micro-controller based ADC (analog to digital)"
    depends on HAVE_GPIO_ADC
config WANT_SPI
    bool "Support communicating with external chips via SPI bus"
    depends on HAVE_GPIO && HAVE_GPIO_SPI
config WANT_SOFTWARE_SPI
    bool "Support software based SPI \"bit-banging\""
    depends on WANT_SPI
config WANT_I2C
    bool "Support communicating with external chips via I2C bus"
    depends on HAVE_GPIO && HAVE_GPIO_I2C
config WANT_SOFTWARE_I2C
    bool "Support software based I2C \"bit-banging\""
    depends on WANT_I2C
config WANT_HARD_PWM
    bool "Support hardware PWM (pulse width modulation)"
    depends on HAVE_GPIO_HARD_PWM
config WANT_BUTTONS
    bool "Support GPIO based button reading"
    depends on HAVE_GPIO
config WANT_TMCUART
    bool "Support Trinamic stepper motor driver UART communication"
    depends on HAVE_GPIO
config WANT_NEOPIXEL
    bool "Support 'neopixel' type LED control (NOT needed for CNC winder)"
    depends on HAVE_GPIO
config WANT_PULSE_COUNTER
    bool "Support encoder/tachometer pulse counting"
    depends on HAVE_GPIO
comment "External sensor chips (NOT needed for CNC winder)"
config WANT_THERMOCOUPLE
    bool "Support thermocouple MAX sensors"
    depends on WANT_SPI
endmenu

# Generic configuration options for CANbus
config CANSERIAL
    bool
config CANBUS
    bool
    default y if CANSERIAL || USBCANBUS
config CANBUS_FREQUENCY
    int "CAN bus speed" if LOW_LEVEL_OPTIONS && CANBUS
    default 1000000
config CANBUS_FILTER
    bool
    default y if CANSERIAL

# Stepper optimizations
config INLINE_STEPPER_HACK
    # Enables gcc to inline stepper_event() into the main timer irq handler
    bool
    depends on HAVE_GPIO
    default y
config HAVE_STEPPER_OPTIMIZED_BOTH_EDGE
    bool
config WANT_STEPPER_OPTIMIZED_BOTH_EDGE
    bool "Optimize stepper code for 'step on both edges'" if LOW_LEVEL_OPTIONS
    depends on INLINE_STEPPER_HACK && HAVE_STEPPER_OPTIMIZED_BOTH_EDGE
    default y
    help
        Optimize the stepper code for Trinamic stepper motor drivers
        that are configured in UART or SPI mode (and thus can perform
        a step on both "edges" of the step pin).  Enabling this option
        typically improves the stepper cpu performance by about 20%
        when using these drivers.  If this option is disabled the code
        will instead deploy optimizations that improve the cpu
        performance by about 20% for traditional drivers (those that
        take a step only on the "rising" or "falling" level of the
        step pin).

# Support setting gpio state at startup
config INITIAL_PINS
    string "GPIO pins to set at micro-controller startup"
    depends on LOW_LEVEL_OPTIONS
    help
        One may specify a comma separated list of gpio pins to set
        during the micro-controller startup sequence. By default the
        pins will be set to output high - preface a pin with a '!'
        character to set that pin to output low.

# The HAVE_x options allow boards to disable support for some commands
# if the hardware does not support the feature.
config HAVE_GPIO
    bool
config HAVE_GPIO_ADC
    bool
config HAVE_GPIO_SPI
    bool
config HAVE_GPIO_SDIO
    bool
config HAVE_GPIO_I2C
    bool
config HAVE_GPIO_HARD_PWM
    bool
config HAVE_STRICT_TIMING
    bool
config HAVE_CHIPID
    bool
config HAVE_BOOTLOADER_REQUEST
    bool
config HAVE_LIMITED_CODE_SIZE
    bool
config HAVE_SOFTWARE_DIVIDE_REQUIRED
    bool
```
